## esp_cam_sensor/Kconfig
```kconfig
menu "Espressif Camera Sensors Configurations"

    rsource "sensors/gc0308/Kconfig.gc0308"
    rsource "sensors/ov2640/Kconfig.ov2640"
    rsource "sensors/ov5645/Kconfig.ov5645"
    rsource "sensors/ov5647/Kconfig.ov5647"
    rsource "sensors/sc030iot/Kconfig.sc030iot"
    rsource "sensors/sc101iot/Kconfig.sc101iot"
    rsource "sensors/sc2336/Kconfig.sc2336"
    rsource "sensors/sc202cs/Kconfig.sc202cs"
    rsource "sensors/sc035hgs/Kconfig.sc035hgs"

    menu "XCLK generator Configuration"
        config LEDC_XCLK_ENABLE
            bool "LEDC-based XCLK generator enable"
            default y
            help
                If enabled, The LEDC-based XCLK generator interface can be used.
    endmenu
endmenu
```

## esp_cam_sensor/sensors/gc2607/Kconfig.gc2607
```kconfig
menuconfig CAMERA_GC2607
    bool "GC2607"
    default n
    depends on SOC_MIPI_CSI_SUPPORTED
    help
        Enable support for the GC2607 CMOS image sensor.

if CAMERA_GC2607
    menu "Auto detect GC2607"
        config CAMERA_GC2607_AUTO_DETECT_MIPI_INTERFACE_SENSOR
            bool "Detect for MIPI CSI interface sensor"
            default y
            depends on SOC_MIPI_CSI_SUPPORTED
            help
                When enabled, the GC2607 sensor will be automatically detected
                and initialized on the MIPI CSI interface at startup without requiring
                manual detection call(gc2607_detect) in your application.
    endmenu

    choice CAMERA_GC2607_MIPI_DEFAULT_FMT
        prompt "Select default output format for MIPI CSI interface"
        default CAMERA_GC2607_MIPI_RAW10_960X540_30FPS
        depends on SOC_MIPI_CSI_SUPPORTED
        help
            This option allows you to select the default video format for the GC2607 sensor
            when it is initialized on the MIPI CSI interface. The selected format will be used
            when the sensor is detected and initialized, and can be changed later when the
            sensor is in stream off state.

        config CAMERA_GC2607_MIPI_RAW10_960X540_30FPS
            bool "RAW10 960x540 30fps, MIPI 2-lane, 24M input"
            help
                RAW10 format at 960x540 resolution with 30fps framerate.
                Requires MIPI CSI-2 2-lane interface with 24MHz input clock.
        config CAMERA_GC2607_MIPI_RAW10_1920X1080_30FPS
            bool "RAW10 1920x1080 30fps, MIPI 2-lane, 24M input"
            help
                RAW10 format at 1920x1080 resolution with 30fps framerate.
                Requires MIPI CSI-2 2-lane interface with 24MHz input clock.
        config CAMERA_GC2607_MIPI_RAW10_960X540_29FPS
            bool "RAW10 960x540 29fps, MIPI 2-lane, 24M input"
            help
                RAW8 format at 960x540 resolution with 29fps framerate.
                Requires MIPI CSI-2 2-lane interface with 24MHz input clock.
    endchoice # CAMERA_GC2607_MIPI_DEFAULT_FMT

    config CAMERA_GC2607_MIPI_IF_FORMAT_INDEX_DEFAULT
        int
        depends on SOC_MIPI_CSI_SUPPORTED
        default 0 if CAMERA_GC2607_MIPI_RAW10_960X540_30FPS
        default 1 if CAMERA_GC2607_MIPI_RAW10_1920X1080_30FPS
        default 2 if CAMERA_GC2607_MIPI_RAW10_960X540_29FPS
        help
            Sets the default configuration for the MIPI CSI interface.
            Use query_support_formats() API to get more format options.

    choice CAMERA_GC2607_IPA_JSON_CONFIGURATION_FILE
        prompt "IPA Configuration File"
        default CAMERA_GC2607_DEFAULT_IPA_JSON_CONFIGURATION_FILE
        help
            Select the Image Processing Algorithm (IPA) JSON configuration file
            for the GC2607 sensor.

        config CAMERA_GC2607_DEFAULT_IPA_JSON_CONFIGURATION_FILE
            bool "Use default configuration"
            help
                Use the built-in default IPA configuration file:
                "esp_cam_sensor/sensors/gc2607/cfg/gc2607_mono_default.json"

                This configuration provides optimized settings for monochrome
                machine vision applications and is recommended for most use cases.

        config CAMERA_GC2607_CUSTOMIZED_IPA_JSON_CONFIGURATION_FILE
            bool "Use custom configuration"
            help
                Use a custom IPA configuration file with your own optimized settings.

                This option allows you to fine-tune sensor parameters for specific
                lighting conditions, exposure requirements, or application needs.

                You must specify the custom file path in the configuration below.
    endchoice

    config CAMERA_GC2607_CUSTOMIZED_IPA_JSON_CONFIGURATION_FILE_PATH
        string "Custom IPA configuration file path"
        depends on CAMERA_GC2607_CUSTOMIZED_IPA_JSON_CONFIGURATION_FILE
        help
            Specify the path to your custom GC2607 IPA JSON configuration file.

            The path is relative to your project root directory.

            Example: "components/my_camera_config/gc2607_custom.json"

            Ensure the file exists and contains valid JSON configuration
            parameters compatible with the GC2607 global shutter sensor.
endif
```

## esp_video/examples/color_detect/sdkconfig.defaults.esp32c5
```kconfig
CONFIG_CAMERA_BF3901=y
CONFIG_CAMERA_BF3901_AUTO_DETECT_SPI_INTERFACE_SENSOR=y
CONFIG_CAMERA_BF3901_SPI_RGB565_240X320_15FPS=y
CONFIG_CAMERA_BF3901_SPI_DEFAULT_FMT_RGB565_240X320_15FPS=y

CONFIG_ESP_VIDEO_ENABLE_SPI_VIDEO_DEVICE=y

CONFIG_EXAMPLE_ENABLE_SPI_CAM_SENSOR=y

CONFIG_SPIRAM=y
CONFIG_SPIRAM_SPEED_80M=y

CONFIG_PARTITION_TABLE_CUSTOM=y
CONFIG_PARTITION_TABLE_CUSTOM_FILENAME="partitions.csv"

CONFIG_FREERTOS_HZ=1000
CONFIG_COMPILER_OPTIMIZATION_PERF=y
#
# Serial flasher config
#
CONFIG_ESPTOOLPY_FLASHMODE_QIO=y
CONFIG_ESPTOOLPY_FLASHFREQ_80M=y
CONFIG_ESPTOOLPY_FLASHSIZE_4MB=y
CONFIG_ESP_TASK_WDT_TIMEOUT_S=50
```
